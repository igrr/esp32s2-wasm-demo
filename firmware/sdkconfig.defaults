## firmware/sdkconfig.defaults
```kconfig
CONFIG_IDF_TARGET="esp32s2"
CONFIG_COMPILER_CXX_EXCEPTIONS=y

# Increased stack size
CONFIG_ESP_MAIN_TASK_STACK_SIZE=32768

# Increase CPU frequency
CONFIG_ESP32S2_DEFAULT_CPU_FREQ_240=y
CONFIG_TINYUSB=y
CONFIG_TINYUSB_MSC_ENABLED=y

CONFIG_ESP_TASK_WDT_CHECK_IDLE_TASK_CPU0=n

CONFIG_PARTITION_TABLE_CUSTOM=y
CONFIG_PARTITION_TABLE_CUSTOM_FILENAME="partitions.csv"
CONFIG_PARTITION_TABLE_FILENAME="partitions.csv"
CONFIG_ESPTOOLPY_FLASHSIZE_4MB=y
CONFIG_WL_SECTOR_SIZE_512=y
CONFIG_WL_SECTOR_MODE_PERF=y

CONFIG_FATFS_LFN_HEAP=y
CONFIG_FATFS_API_ENCODING_UTF_8=y
CONFIG_ESP32S2_SPIRAM_SUPPORT=y
CONFIG_FREERTOS_WATCHPOINT_END_OF_STACK=y
CONFIG_SPIRAM_MALLOC_ALWAYSINTERNAL=64
```
